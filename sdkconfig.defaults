## sdkconfig.defaults
```kconfig
# ESP-IDF Default Configuration für den ESP32-C6 Reaktionstest

# Build target (replaces `idf.py set-target esp32c6`)
CONFIG_IDF_TARGET="esp32c6"

# Flash size — must match the physical chip (ESP32-C6-DevKitC-1 has 8 MB).
# PlatformIO's board profile set this implicitly; in raw ESP-IDF we set it
# explicitly. The custom partition table below requires more than 2 MB.
CONFIG_ESPTOOLPY_FLASHSIZE_8MB=y
CONFIG_ESPTOOLPY_FLASHSIZE="8MB"

# Custom partition table (replaces PlatformIO's `board_build.partitions`)
CONFIG_PARTITION_TABLE_CUSTOM=y
CONFIG_PARTITION_TABLE_CUSTOM_FILENAME="partitions.csv"
CONFIG_PARTITION_TABLE_FILENAME="partitions.csv"

# FreeRTOS Configuration
CONFIG_FREERTOS_HZ=1000
CONFIG_FREERTOS_USE_TRACE_FACILITY=y
CONFIG_FREERTOS_GENERATE_RUN_TIME_STATS=y

# I2C Configuration
CONFIG_I2C_ISR_IRAM_SAFE=n

# Logging Configuration
CONFIG_LOG_DEFAULT_LEVEL_INFO=y
CONFIG_LOG_DEFAULT_LEVEL=3
CONFIG_LOG_MAXIMUM_LEVEL=4
CONFIG_LOG_COLORS=n

# Stack sizes
CONFIG_ESP_MAIN_TASK_STACK_SIZE=4096

# Watchdog
CONFIG_ESP_TASK_WDT_TIMEOUT_S=10
CONFIG_ESP_TASK_WDT_CHECK_IDLE_TASK_CPU0=y
```
